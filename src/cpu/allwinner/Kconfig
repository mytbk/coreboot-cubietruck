## src/cpu/allwinner/Kconfig
```kconfig
source src/cpu/allwinner/a10/Kconfig
source src/cpu/allwinner/a20/Kconfig

config MACH_SUN4I
       bool

config MACH_SUN5I
       bool
       
config MACH_SUN7I
       bool
       
```

## src/mainboard/cubietech/Kconfig
```kconfig
if VENDOR_CUBIETECH

# Auto select common options
choice
	prompt "Mainboard model"

config BOARD_CUBIETECH_CUBIEBOARD
	bool "Cubieboard"

config BOARD_CUBIETECH_CUBIETRUCK
	bool "Cubietruck"
       
endchoice

source "src/mainboard/cubietech/cubieboard/Kconfig"
source "src/mainboard/cubietech/cubietruck/Kconfig"

config MAINBOARD_VENDOR
	string
	default "Cubietech"

endif # VENDOR_CUBIETECH
```

## src/mainboard/cubietech/cubietruck/Kconfig
```kconfig
if BOARD_CUBIETECH_CUBIETRUCK

config BOARD_SPECIFIC_OPTIONS # dummy
	def_bool y
	select CPU_ALLWINNER_A20
	select BOARD_ROMSIZE_KB_4096
	select DRIVER_XPOWERS_AXP209
	select MAINBOARD_HAS_BOOTBLOCK_INIT

config MAINBOARD_DIR
	string
	default cubietech/cubietruck

config MAINBOARD_PART_NUMBER
	string
	default "Cubietruck A20"

config MAX_CPUS
	int
	default 2

config DRAM_SIZE_MB
	int
	default 2048

config UART_FOR_CONSOLE
	int
	default 0

endif # BOARD_CUBIETECH_CUBIETRUCK
```
